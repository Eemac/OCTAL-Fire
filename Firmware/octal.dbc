BO_ 1 BMS1_STATUS: 7 BMS
 SG_ BMS_OK : 0|1@0- (1,0) [0|1] "BOOL" EON
